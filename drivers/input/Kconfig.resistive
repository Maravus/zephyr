## drivers/input/Kconfig.resistive
```kconfig
# Copyright (c) 2020 NXP
# Copyright (c) 2020 Teslabs Engineering S.L.
# SPDX-License-Identifier: Apache-2.0

menuconfig INPUT_RESISTIVE
	bool "resistive touch panel driver"
	default y
	depends on DT_HAS_INPUT_RESISTIVE_ENABLED
	select INPUT_TOUCH
	help
	  Enable driver for resistive touch panel controllers.

if INPUT_RESISTIVE

config INPUT_RESISTIVE_MANUAL
	bool "Manual mode"
	help
	  Trigger position measurements manually.

config INPUT_RESISTIVE_PERIOD
	int "Sample period"
	depends on !INPUT_RESISTIVE_MANUAL
	default 10
	help
	  Sample period in milliseconds when in polling mode.

config INPUT_RESISTANCE_PLATE_RESISTANCE
    int "Plate resistance"
    default 300
    help
      Plate resistance between the X-plate

config INPUT_RESISTANCE_TOUCH_DETECTION_THRESHOLD
    int "touch detection threshold"
    default 20
    help
      The resistive touch panel can detect how strong
      the touch is. To avoid false positives one can
      adjust this value.

endif # INPUT_RESISTIVE
```

## drivers/mipi_dbi/Kconfig.rpi_pico
```kconfig
# Copyright 2024 Stefan Gloor
# SPDX-License-Identifier: Apache-2.0

config MIPI_DBI_RPI_PICO_PIO
	bool "MIPI DBI driver using PIO"
	default y
	depends on DT_HAS_RASPBERRYPI_PICO_MIPI_DBI_PIO_ENABLED
	select GPIO
	select PICOSDK_USE_PIO
	select PICOSDK_USE_DMA
	select PICOSDK_USE_IRQ
	help
	  Enable support for MIPI DBI driver. This driver implements
	  a MIPI-DBI mode A and B compatible controller using PIO.

config MIPI_DBI_RPI_PICO_PIO_CLOCK_DIV
    	int "Clock divisor for PIO state machine"
    	default 1
    	range 1 65536
    	help
    	  Rather than slowing the system clock itself, the clock divider redefines how many system clock periods are considered
          to be "one cycle", for execution purposes.
```

## dts/bindings/input/input-resistive.yaml
```yaml
# Copyright (c) 2020,2023 NXP
# SPDX-License-Identifier: Apache-2.0

description: resistive touch panel

compatible: "input-resistive"

include: [touchscreen-common.yaml]

properties:
  xm-gpios:
    type: phandle-array
    description: |
      Must be an analog pin
  xp-gpios:
    type: phandle-array
    description: |
      Can be any pin (analog/digital)
  yp-gpios:
    type: phandle-array
    description: |
      Must be an analog pin
  ym-gpios:
    type: phandle-array
    description: |
      Can be any pin (analog/digital)
```
